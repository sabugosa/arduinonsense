/*************************************************************
project: Mallandro library
author: Alex Porto

description: Reproduz uma das classicas falas de 
Sergio Mallandro no Arduino. 

Usa a biblioteca PCM, de  Michael Smith, que deve estar 
presente.
*************************************************************/

#include "mallandro.h"

/* ieie-Raaa! */ 
const unsigned char __mallandro_sound_sampleXX[] PROGMEM = {
	117, 115, 117, 115, 119, 123, 123, 127, 130, 126, 127, 128,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 118, 
	// ieie 134, 121, 117, 117, 95, 94, 114, 113, 125, 147, 140, 145, 161,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 129
};

//-----------------------------------------------------------------------------

Mallandro::Mallandro(char soundPin, char ledPin)
{
	soundPort = soundPin;
	ledPort = ledPin;
	playing = false;
	lastTime = 0;
	delayTime = 1700;
}

//-----------------------------------------------------------------------------

void Mallandro::Initialize(void)
{
	if (ledPort >= 0) {
		pinMode(ledPort, OUTPUT);
		digitalWrite(ledPort, LOW);
	}
}

//-----------------------------------------------------------------------------

void Mallandro::Play(bool playNow)
{
	if (playing) {
		if (millis() - lastTime >= delayTime) {
			playing = false;
			if (ledPort >= 0) {
				digitalWrite(ledPort, LOW);			
			}
		} 
		return;
	} else { 
		if (playNow == false) {
			return;
		}
	
		if (millis() - lastTime < delayTime) {
			return;
		} 		
	}
		
	playing = true;
	lastTime = millis();
	
	if (ledPort >= 0) {
		digitalWrite(ledPort, HIGH);			
	}
	startPlayback(__mallandro_sound_sampleXX, sizeof(__mallandro_sound_sampleXX));	
}

//-----------------------------------------------------------------------------

void Mallandro::Stop(void)
{
	stopPlayback();
	playing = false;
	lastTime = 0;
}

//-----------------------------------------------------------------------------
